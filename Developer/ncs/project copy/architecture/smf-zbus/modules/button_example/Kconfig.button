## Developer/ncs/project copy/architecture/smf-zbus/modules/button_example/Kconfig.button
```kconfig
#
# Copyright (c) 2024 Nordic Semiconductor ASA
#
# SPDX-License-Identifier: LicenseRef-Nordic-5-Clause
#

menu "Button Module"

config APP_BUTTON_STACK_SIZE
	int "Button module thread stack size"
	default 2048
	help
	  Stack size for the button module thread in bytes.

config APP_BUTTON_PRIORITY
	int "Button module thread priority"
	default 7
	range 0 14
	help
	  Thread priority (0 = highest, 14 = lowest for cooperative threads).

config APP_BUTTON_LONG_PRESS_TIMEOUT_MS
	int "Long press timeout in milliseconds"
	default 3000
	help
	  Time in milliseconds that a button must be held to be considered
	  a long press. Short presses are detected when the button is
	  released before this timeout expires.

config APP_BUTTON_MSG_PROCESSING_TIMEOUT_SECONDS
	int "Message processing timeout in seconds"
	default 30
	help
	  Maximum time to wait for zbus messages before running state machine anyway.

config APP_BUTTON_WATCHDOG_TIMEOUT_SECONDS
	int "Watchdog timeout in seconds"
	default 60
	help
	  Watchdog timeout for the button module. Must be greater than
	  message processing timeout.

module = APP_BUTTON
module-str = Button
source "subsys/logging/Kconfig.template.log_config"

endmenu # Button Module
```

## Developer/ncs/project copy/examples/basic_app/Kconfig
```kconfig
#
# Copyright (c) 2026 Nordic Semiconductor ASA
#
# SPDX-License-Identifier: LicenseRef-Nordic-5-Clause
#

source "Kconfig.zephyr"

menu "Basic NCS Application"

config BASIC_APP_LED_BLINK_INTERVAL_MS
    int "LED blink interval in milliseconds"
    range 100 10000
    default 1000
    help
      The interval between LED state changes in milliseconds.

config BASIC_APP_ENABLE_SHELL
    bool "Enable shell commands for the application"
    default y
    help
      Enable custom shell commands for controlling the application.

endmenu
```

## skills/chsh-sk-ncs-project/architecture/simple-multithreaded/templates/Kconfig.module_template_simple
```kconfig
# Copyright (c) 2024 Nordic Semiconductor ASA
# SPDX-License-Identifier: LicenseRef-Nordic-5-Clause

menuconfig MODULE_TEMPLATE
	bool "Enable Module Template (Simple Multi-Threaded)"
	default n
	help
	  Enable the simple multi-threaded module template.
	  This uses traditional RTOS patterns with message queues,
	  semaphores, and mutexes.

if MODULE_TEMPLATE

config MODULE_TEMPLATE_STACK_SIZE
	int "Module thread stack size"
	default 2048
	help
	  Stack size for the module thread in bytes.
	  Increase if experiencing stack overflow.
	  Typical range: 1024-4096 bytes.

config MODULE_TEMPLATE_PRIORITY
	int "Module thread priority"
	default 7
	range 0 14
	help
	  Thread priority (0 = highest, 14 = lowest cooperative threads).
	  Default: 7 (medium priority)
	  - Use lower numbers (0-6) for time-critical operations
	  - Use higher numbers (8-14) for background tasks

module = MODULE_TEMPLATE
module-str = Module Template Simple
source "subsys/logging/Kconfig.template.log_config"

config MODULE_TEMPLATE_MSGQ_SIZE
	int "Message queue size"
	default 10
	range 1 100
	help
	  Number of messages that can be queued.
	  Increase if messages are being dropped.
	  Each message consumes RAM.

config MODULE_TEMPLATE_OPERATION_TIMEOUT_SEC
	int "Operation timeout in seconds"
	default 5
	range 1 60
	help
	  Timeout for blocking operations (init, start, stop).
	  Adjust based on expected operation duration.

# Add module-specific configurations below
# Example:
# config MODULE_TEMPLATE_ENABLE_FEATURE_X
#	bool "Enable feature X"
#	default n
#	help
#	  Enable additional feature X.

endif # MODULE_TEMPLATE
```

## skills/chsh-sk-ncs-project/architecture/smf-zbus/modules/sensor_example/Kconfig.sensor
```kconfig
#
# Copyright (c) 2024 Nordic Semiconductor ASA
#
# SPDX-License-Identifier: LicenseRef-Nordic-5-Clause
#

menu "Sensor Module"

config APP_SENSOR_STACK_SIZE
	int "Sensor module thread stack size"
	default 2048

config APP_SENSOR_PRIORITY
	int "Sensor module thread priority"
	default 7
	range 0 14

config APP_SENSOR_SAMPLE_INTERVAL_SECONDS
	int "Sensor sampling interval in seconds"
	default 10
	help
	  Time between sensor readings when sampling is active.

config APP_SENSOR_MSG_PROCESSING_TIMEOUT_SECONDS
	int "Message processing timeout in seconds"
	default 30

config APP_SENSOR_WATCHDOG_TIMEOUT_SECONDS
	int "Watchdog timeout in seconds"
	default 60

module = APP_SENSOR
module-str = Sensor
source "subsys/logging/Kconfig.template.log_config"

endmenu # Sensor Module
```

## skills/chsh-sk-ncs-project/architecture/smf-zbus/templates/Kconfig.module_template
```kconfig
#
# Module Template Kconfig
#
# Add this to your main Kconfig file or src/Kconfig.modules

menu "Module Template"

config APP_MODULE_TEMPLATE
	bool "Enable module template"
	default y
	help
	  Enable the module template.

if APP_MODULE_TEMPLATE

config APP_MODULE_TEMPLATE_STACK_SIZE
	int "Module template thread stack size"
	default 2048
	help
	  Stack size for the module template thread.

config APP_MODULE_TEMPLATE_THREAD_PRIORITY
	int "Module template thread priority"
	default 7
	help
	  Thread priority for the module template (lower number = higher priority).
	  Range: 0 (highest) to 14 (lowest), with wifi/network typically at 7.

config APP_MODULE_TEMPLATE_WATCHDOG_TIMEOUT_SECONDS
	int "Watchdog timeout in seconds"
	default 60
	help
	  Timeout in seconds for the module watchdog.
	  Must be greater than MSG_PROCESSING_TIMEOUT_SECONDS.

config APP_MODULE_TEMPLATE_MSG_PROCESSING_TIMEOUT_SECONDS
	int "Message processing timeout in seconds"
	default 30
	help
	  Maximum time allowed for processing a single message.
	  Must be less than WATCHDOG_TIMEOUT_SECONDS.

module = APP_MODULE_TEMPLATE
module-str = Module Template
source "subsys/logging/Kconfig.template.log_config"

endif # APP_MODULE_TEMPLATE

endmenu
```
